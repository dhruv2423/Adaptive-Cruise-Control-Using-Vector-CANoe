VERSION ""

NS_ :

BS_:

BU_: EngineRpmControl VehicleSpeedControl Radar_Data

BO_ 3 c_rpm: 4 EngineRpmControl
 SG_ Current_RPM : 7|32@0+ (1,0) [0|2000] ""  VehicleSpeedControl

BO_ 4 brakemessage: 1 VehicleSpeedControl
 SG_ brakeval : 7|8@0+ (1,0) [0|1] ""  EngineRpmControl

BO_ 5 Accelerator: 1 VehicleSpeedControl
 SG_ AcceleratorCommand : 7|8@0+ (1,0) [0|1] ""  EngineRpmControl

BO_ 2 FVSpeed: 4 Radar_Data
 SG_ ForwardVehicleSpeed : 7|32@0+ (1,0) [0|2000] ""  EngineRpmControl,VehicleSpeedControl

BA_DEF_ SG_  "GenSigStartValue" FLOAT 0 100000000000;
BA_DEF_ SG_  "GenSigSendType" ENUM  "Cyclic","OnWrite","OnWriteWithRepetition","OnChange","OnChangeWithRepetition","IfActive","IfActiveWithRepetition","NoSigSendType","NotUsed","NotUsed","NotUsed","NotUsed","NotUsed";
BA_DEF_ BO_  "GenMsgSendType" ENUM  "Cyclic","NotUsed","NotUsed","NotUsed","NotUsed","Cyclic","NotUsed","IfActive","NoMsgSendType","NotUsed","vector_leerstring";
BA_DEF_ BO_  "GenMsgCycleTime" INT 0 50000;
BA_DEF_ BO_  "GenMsgILSupport" ENUM  "No","Yes";
BA_DEF_ BU_  "NmStationAddress" INT 0 63;
BA_DEF_ BU_  "NodeLayerModules" STRING ;
BA_DEF_ BU_  "NodeLayerModule" STRING ;
BA_DEF_  "NmBaseAddress" HEX 1024 1087;
BA_DEF_  "BusType" STRING ;
BA_DEF_DEF_  "GenSigStartValue" 0;
BA_DEF_DEF_  "GenSigSendType" "Cyclic";
BA_DEF_DEF_  "GenMsgSendType" "NoMsgSendType";
BA_DEF_DEF_  "GenMsgCycleTime" 0;
BA_DEF_DEF_  "GenMsgILSupport" "Yes";
BA_DEF_DEF_  "NmStationAddress" 0;
BA_DEF_DEF_  "NodeLayerModules" "CANoeILNLVector.dll";
BA_DEF_DEF_  "NodeLayerModule" "CANoeILNLVector.dll";
BA_DEF_DEF_  "NmBaseAddress" 1024;
BA_DEF_DEF_  "BusType" "CAN";
BA_ "NmStationAddress" BU_ EngineRpmControl 3;
BA_ "NmStationAddress" BU_ VehicleSpeedControl 2;
BA_ "NmStationAddress" BU_ Radar_Data 1;
BA_ "GenMsgCycleTime" BO_ 3 100;
BA_ "GenMsgCycleTime" BO_ 2 100;
BA_ "GenSigStartValue" SG_ 3 Current_RPM 100;
BA_ "GenSigStartValue" SG_ 2 ForwardVehicleSpeed 100;
